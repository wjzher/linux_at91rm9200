## arch/arm/mach-at91rm9200/Kconfig
```kconfig
if ARCH_AT91RM9200

menu "AT91RM9200 Implementations"

config ARCH_AT91RM9200DK
	bool "Atmel AT91RM9200-DK Development board"
	depends on ARCH_AT91RM9200
	help
	  Select this if you are using Atmel's AT91RM9200-DK Development board

config MACH_AT91RM9200EK
	bool "Atmel AT91RM9200-EK Evaluation Kit"
	depends on ARCH_AT91RM9200
	help
	  Select this if you are using Atmel's AT91RM9200-EK Evaluation Kit

config MACH_CSB337
	bool "Cogent CSB337 board"
	depends on ARCH_AT91RM9200
	help
	  Select this if you are using Cogent's CSB337 board

config MACH_CSB637
	bool "Cogent CSB637 board"
	depends on ARCH_AT91RM9200
	help
	  Select this if you are using Cogent's CSB637 board

config MACH_CARMEVA
	bool "Conitec's ARM&EVA"
	depends on ARCH_AT91RM9200
	help
	  Select this if you are using Conitec's AT91RM9200-MCU-Module

endmenu

endif
```

## drivers/char/nkty-common/Kconfig
```kconfig
#
# NKTY all dev configuration
#
menu "NKTY common device driver"


config NKTYCOMMON
	bool "NKTY common device driver"
	depends on ARCH_AT91RM9200
	default n

config AT91_HASHTAB
    bool "NKTY common hash tab lib"
    depends on ARCH_AT91RM9200 && NKTYCOMMON

config AT91_USRI2C_COMMON
	bool "AT91 user i2c interface"
	depends on ARCH_AT91RM9200 && NKTYCOMMON
	default n
	help
	  The user i2c interface gives support for FRAM and ds137 and ZLG7290 on AT91RM9200

config ZLG_7290B
	bool "Support LED Ctrl ZLG_7290B"
	depends on ARCH_AT91RM9200 && NKTYCOMMON && AT91_USRI2C_COMMON
	default n

config AT91_SED1335_COMMON
	bool "AT91 LCD driver (sed1335)"
	depends on ARCH_AT91RM9200 && NKTYCOMMON
	default n
	help
	  The LCD driver support epson sed1335 on AT91RM9200

config AT91_GPIOB_COMMON
	bool "AT91 GPIOB driver"
	depends on ARCH_AT91RM9200 && NKTYCOMMON
	default n
	help
	  The GPIOB driver gives key interface on AT91RM9200

config AT91_DATAFLASH_COMMON
	bool "AT91 DATAFLASH driver"
	depends on ARCH_AT91RM9200 && NKTYCOMMON
	default n
	help
	  The DATAFLASH driver gives AT45DB642 on AT91RM9200

config AT91_FLASH_COMMON
        bool "AT91 FLASH  driver"
        depends on ARCH_AT91RM9200 && NKTYCOMMON
        default n


endmenu
```

## drivers/char/nkty_common/Kconfig
```kconfig
#
# NKTY all dev configuration
#

menu "NKTY common device driver"

config NKTYCOMMON
	bool "NKTY common device driver"
	depends on ARCH_AT91RM9200
	default n

config AT91_USRI2C
	bool "AT91 user i2c interface"
	depends on ARCH_AT91RM9200 && NKTYCOMMON
	default y
	help
	  The user i2c interface gives support for FRAM and ds137 and ZLG7290 on AT91RM9200

config ZLG_7290B
	bool "Support LED Ctrl ZLG_7290B"
	depends on ARCH_AT91RM9200 && NKTYCOMMON && AT91_USRI2C
	default y

config AT91_SED1335
	bool "AT91 LCD driver (sed1335)"
	depends on ARCH_AT91RM9200 && NKTYCOMMON
	default y
	help
	  The LCD driver support epson sed1335 on AT91RM9200

config AT91_GPIOB
	bool "AT91 GPIOB driver"
	depends on ARCH_AT91RM9200 && NKTYCOMMON
	default n
	help
	  The GPIOB driver gives key interface on AT91RM9200

config AT91_DATAFLASH
	bool "AT91 DATAFLASH driver"
	depends on ARCH_AT91RM9200 && NKTYCOMMON
	default y
	help
	  The DATAFLASH driver gives AT45DB642 on AT91RM9200

config AT91_FLASH
        bool "AT91 FLASH  driver"
        depends on ARCH_AT91RM9200 && NKTYCOMMON
        default y

endmenu
```

## drivers/char/nktydev/Kconfig
```kconfig
#
# NKTY all dev configuration
#

menu "NKTY devices"

config NKTYDEV
	bool "NKTY devices"
        default y

config AT91_UART
	bool "AT91 485 driver"
	depends on ARCH_AT91RM9200 && NKTYDEV
	default y
	help
	  The 485 driver gives 485 COM

config ACCSW_USE_HASH
	bool "Account area use hash table"
    select AT91_HASHTAB
    select NKTYCOMMON
	depends on ARCH_AT91RM9200 && NKTYDEV && AT91_UART
	default y

config FORCE_DISC
    bool "all term force discount enable"
    depends on ARCH_AT91RM9200 && NKTYDEV && AT91_UART
    default y


config SUBCNT
    bool "sub cnt version enable"
    depends on ARCH_AT91RM9200 && NKTYDEV && AT91_UART
    default n

config ZLYY
    bool "zlyy version"
    depends on ARCH_AT91RM9200 && NKTYDEV && AT91_UART
    default n

config RECORD_CASHTERM
	bool "Record cash terminal status"
	depends on ARCH_AT91RM9200 && NKTYDEV && AT91_UART
	default y

config CNTVER
	bool "CNTVER Version Support"
	depends on ARCH_AT91RM9200 && NKTYDEV && AT91_UART
	default n

config UART_WATER
	bool "Support water control"
	depends on ARCH_AT91RM9200 && NKTYDEV && AT91_UART
	default n
	help
	  support water control terminal

config QH_WATER
	bool "Support QingHua Water control"
	depends on ARCH_AT91RM9200 && NKTYDEV && AT91_UART && UART_WATER
	default n
	help
	  support water control terminal, QH version
config HAIYIN
    bool "Support Haiyin H-ID Card"
    depends on ARCH_AT91RM9200 && NKTYDEV && AT91_UART
    default n

config RDFZ
    bool "Support RDFZ Cash Terminal"
    depends on ARCH_AT91RM9200 && NKTYDEV && AT91_UART
    default y

config REFUND
    bool "Support Refund POS"
    depends on ARCH_AT91RM9200 && NKTYDEV && AT91_UART
    default n

config AT91_USRI2C
	bool "AT91 user i2c interface"
	depends on ARCH_AT91RM9200 && NKTYDEV
	default n
	help
	  The user i2c interface gives support for FRAM and ds137
	  on AT91RM9200

config AT91_USRI2C_GPIO
    bool "AT91 user i2c interface, use gpio"
    depends on ARCH_AT91RM9200 && NKTYDEV && !AT91_USRI2C
    default y
    help
        The i2c interface use gpio

config AT91_SED1335
	bool "AT91 LCD driver (sed1335)"
	depends on ARCH_AT91RM9200 && NKTYDEV
	default y
	help
	  The LCD driver support epson sed1335 on AT91RM9200

config AT91_GPIOB
	bool "AT91 GPIOB driver"
	depends on ARCH_AT91RM9200 && NKTYDEV
	default y
	help
	  The GPIOB driver gives key interface on AT91RM9200

config OLDHALTCHK
	bool "Use old mode halt system"
	depends on ARCH_AT91RM9200 && NKTYDEV && AT91_GPIOB
	default n

config AT91_DATAFLASH
	bool "AT91 DATAFLASH driver"
	depends on ARCH_AT91RM9200 && NKTYDEV
	default y
	help
	  The DATAFLASH driver gives AT45DB642 on AT91RM9200

config AT91_TTY
	bool "AT91 TTY test driver"
	depends on ARCH_AT91RM9200 && NKTYDEV
	default n

endmenu
```

## drivers/char/nktydev1.2/Kconfig
```kconfig
#
# NKTY all dev configuration
#

menu "NKTY devices 1.2"

config NKTYDEV12
	bool "NKTY devices 1.2"

config AT91_UART
	bool "AT91 485 driver"
	depends on ARCH_AT91RM9200 && NKTYDEV12
	default y
	help
	  The 485 driver gives 485 COM

config ACCSW_USE_HASH
	bool "Account area use hash table"
    select AT91_HASHTAB
    select NKTYCOMMON
	depends on ARCH_AT91RM9200 && NKTYDEV12 && AT91_UART
	default y

config RECORD_CASHTERM
	bool "Record cash terminal status"
	depends on ARCH_AT91RM9200 && NKTYDEV12 && AT91_UART
	default y


config AT91_USRI2C
	bool "AT91 user i2c interface"
	depends on ARCH_AT91RM9200 && NKTYDEV12
	default n
	help
	  The user i2c interface gives support for FRAM and ds137
	  on AT91RM9200

config AT91_USRI2C_GPIO
	bool "AT91 user i2c interface, use gpio"
	depends on ARCH_AT91RM9200 && NKTYDEV12 && !AT91_USRI2C
	default n
	help
		The i2c interface use gpio

config AT91_SED1335
	bool "AT91 LCD driver (sed1335)"
	depends on ARCH_AT91RM9200 && NKTYDEV12
	default y
	help
	  The LCD driver support epson sed1335 on AT91RM9200

config AT91_GPIOB
	bool "AT91 GPIOB driver"
	depends on ARCH_AT91RM9200 && NKTYDEV12
	default y
	help
	  The GPIOB driver gives key interface on AT91RM9200

config OLDHALTCHK
	bool "Use old mode halt system"
	depends on ARCH_AT91RM9200 && NKTYDEV12 && AT91_GPIOB
	default n

config AT91_DATAFLASH
	bool "AT91 DATAFLASH driver"
	depends on ARCH_AT91RM9200 && NKTYDEV12
	default n
	help
	  The DATAFLASH driver gives AT45DB642 on AT91RM9200

endmenu
```

## drivers/char/nktydev2012/Kconfig
```kconfig
#
# NKTY all dev configuration
#

menu "NKTY devices 2012"

config NKTYDEV2012
	bool "NKTY devices 2012"

config AT91_UART
	bool "AT91 485 driver"
	select AT91_HASHTAB
	select NKTYCOMMON
	depends on ARCH_AT91RM9200 && NKTYDEV2012
	default y
	help
	  The 485 driver gives 485 COM

config NKTYCPUCARD
	bool "Support CPU Card"
	depends on ARCH_AT91RM9200 && NKTYDEV2012 && AT91_UART
	default n
	help
	  Support CPU Card

config RECORD_CASHTERM
	bool "Record cash terminal status"
	depends on ARCH_AT91RM9200 && NKTYDEV2012 && AT91_UART
	default y
	
config UART_V2
	bool "Uart Version 2.0"
	depends on ARCH_AT91RM9200 && NKTYDEV2012 && AT91_UART
	default y

config AT91_USRI2C
	bool "AT91 user i2c interface"
	depends on ARCH_AT91RM9200 && NKTYDEV2012
	default n
	help
	  The user i2c interface gives support for FRAM and ds137
	  on AT91RM9200

config AT91_USRI2C_GPIO
	bool "AT91 user i2c interface, use gpio"
	depends on ARCH_AT91RM9200 && NKTYDEV2012 && !AT91_USRI2C
	default y
	help
	  The user i2c interface gives support for FRAM and ds137
	  on AT91RM9200
	
	
config AT91_SED1335
	bool "AT91 LCD driver (sed1335)"
	depends on ARCH_AT91RM9200 && NKTYDEV2012
	default y
	help
	  The LCD driver support epson sed1335 on AT91RM9200

config AT91_GPIOB
	bool "AT91 GPIOB driver"
	depends on ARCH_AT91RM9200 && NKTYDEV2012
	default y
	help
	  The GPIOB driver gives key interface on AT91RM9200

config AT91_DATAFLASH
	bool "AT91 DATAFLASH driver"
	depends on ARCH_AT91RM9200 && NKTYDEV2012
	default y
	help
	  The DATAFLASH driver gives AT45DB642 on AT91RM9200

endmenu
```

## drivers/char/nktydev21CR/Kconfig
```kconfig
#
# NKTY all dev configuration
#

menu "NKTY devices 21CR"

config NKTYDEV21CR
	bool "NKTY devices 21CR"

config AT91_UART
	bool "AT91 485 driver"
	depends on ARCH_AT91RM9200 && NKTYDEV21CR
	default y
	help
	  The 485 driver gives 485 COM

config RECORD_CASHTERM
	bool "Record cash terminal status"
	depends on ARCH_AT91RM9200 && NKTYDEV21CR && AT91_UART
	default n

config AT91_USRI2C
	bool "AT91 user i2c interface"
	depends on ARCH_AT91RM9200 && NKTYDEV21CR
	default y
	help
	  The user i2c interface gives support for FRAM and ds137
	  on AT91RM9200

#config ZLG_7290B
#	bool "Support ZLG_7290B?"
#	depends on ARCH_AT91RM9200 && NKTYDEV21CR && AT91_USRI2C
#	default y
	
config AT91_USRI2C_GPIO
	bool "AT91 user i2c interface, use gpio"
	depends on ARCH_AT91RM9200 && NKTYDEV21CR && !AT91_USRI2C

#config I2C_DISABLEIRQ
#	bool "Disable irq on writing or reading data"
#	depends on ARCH_AT91RM9200 && NKTYDEV21CR && AT91_USRI2C
#	default n

config AT91_SED1335
	bool "AT91 LCD driver (sed1335)"
	depends on ARCH_AT91RM9200 && NKTYDEV21CR
	default y
	help
	  The LCD driver support epson sed1335 on AT91RM9200

config AT91_GPIOB
	bool "AT91 GPIOB driver"
	depends on ARCH_AT91RM9200 && NKTYDEV21CR
	default n
	help
	  The GPIOB driver gives key interface on AT91RM9200

config AT91_DATAFLASH
	bool "AT91 DATAFLASH driver"
	depends on ARCH_AT91RM9200 && NKTYDEV21CR
	default n
	help
	  The DATAFLASH driver gives AT45DB642 on AT91RM9200

endmenu
```

## drivers/char/nktydev21c_s/Kconfig
```kconfig
#
# NKTY all dev configuration
#

menu "NKTY devices 21c_s"

config NKTYDEV21C_S
	bool "NKTY devices 21c_s"

config AT91_UART
	bool "AT91 485 driver"
	depends on ARCH_AT91RM9200 && NKTYDEV21C_S
	default y
	help
	  The 485 driver gives 485 COM

config UART_INT
	bool "UART485 INT MODE"
	depends on ARCH_AT91RM9200 && NKTYDEV21C_S && AT91_UART
	default n

config AT91_USRI2C
	bool "AT91 user i2c interface"
	depends on ARCH_AT91RM9200 && NKTYDEV21C_S
	default y
	help
	  The user i2c interface gives support for FRAM and ds137
	  on AT91RM9200

config USRI2C_INT
    bool "USRI2C INT MODE"
    depends on ARCH_AT91RM9200 && NKTYDEV21C_S && AT91_USRI2C
    default n
    help
      The user i2c interface use interrupt mode

config AT91_GPIOB
	bool "AT91 GPIOB driver"
	depends on ARCH_AT91RM9200 && NKTYDEV21C_S
	default y
	help
	  The GPIOB driver gives key interface on AT91RM9200

config AT91_DATAFLASH
	bool "AT91 DATAFLASH driver"
	depends on ARCH_AT91RM9200 && NKTYDEV21C_S
	default y
	help
	  The DATAFLASH driver gives AT45DB642 on AT91RM9200

config AT91_FLASH
	bool "AT91_FLASH driver"
	depends on ARCH_AT91RM9200 && NKTYDEV21C_S
	default n

endmenu
```

## drivers/char/posa2/Kconfig
```kconfig
#
# NKTY all dev configuration
#

menu "NKTY devices pos"

config NKTYDEVPOS
	bool "NKTY devices POS"

config AT91_UART
	bool "AT91 485 driver"
	depends on ARCH_AT91RM9200 && NKTYDEVPOS
	default y
	help
	  The 485 driver gives 485 COM

config ACCSW_USE_HASH
	bool "Account area use hash table"
    select AT91_HASHTAB
    select NKTYCOMMON
	depends on ARCH_AT91RM9200 && NKTYDEVPOS && AT91_UART
	default y
	
config RECORD_CASHTERM
	bool "Record cash terminal status"
	depends on ARCH_AT91RM9200 && NKTYDEVPOS && AT91_UART
	default y
	
config ZLYY
	bool "ZLYY"
	depends on ARCH_AT91RM9200 && NKTYDEVPOS && AT91_UART
	default y

config CONFIG_SOUTH
	bool "South Version"
	depends on ARCH_AT91RM9200 && NKTYDEVPOS && AT91_UART && ZLYY
	default n

config AT91_USRI2C
	bool "AT91 user i2c interface"
	depends on ARCH_AT91RM9200 && NKTYDEVPOS
	default n
	help
	  The user i2c interface gives support for FRAM and ds137
	  on AT91RM9200

config AT91_USRI2C_GPIO
	bool "AT91 user i2c interface, use gpio"
	depends on ARCH_AT91RM9200 && NKTYDEVPOS && !AT91_USRI2C
	default y
	help
	  The user i2c interface gives support for FRAM and ds137
	  on AT91RM9200
	
	
config AT91_SED1335
	bool "AT91 LCD driver (sed1335)"
	depends on ARCH_AT91RM9200 && NKTYDEVPOS
	default y
	help
	  The LCD driver support epson sed1335 on AT91RM9200

config AT91_GPIOB
	bool "AT91 GPIOB driver"
	depends on ARCH_AT91RM9200 && NKTYDEVPOS
	default y
	help
	  The GPIOB driver gives key interface on AT91RM9200

config AT91_DATAFLASH
	bool "AT91 DATAFLASH driver"
	depends on ARCH_AT91RM9200 && NKTYDEVPOS
	default y
	help
	  The DATAFLASH driver gives AT45DB642 on AT91RM9200

endmenu
```

## drivers/char/tprtctrl/Kconfig
```kconfig
#
# NKTY all dev configuration
#

menu "NKTY Wen Kong driver"

config NKTYWENKONG
	bool "NKTY Wen Kong driver"
	depends on ARCH_AT91RM9200
	default y

config AT91_WKUART
	bool "AT91 Wen Kong Uart driver"
	depends on ARCH_AT91RM9200 && NKTYWENKONG
	default y
	help
	  Wen Kong Uart driver
config WENKONG_DEBUG
	bool "Wen Kong debug?"
	depends on ARCH_AT91RM9200 && NKTYWENKONG
	default n

config TPRT_NC
	bool "Support new power control"
	depends on ARCH_AT91RM9200 && NKTYWENKONG
	default n

endmenu
```
